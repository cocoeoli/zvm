## CMakeLists.txt
```
# SPDX-License-Identifier: Apache-2.0

cmake_minimum_required(VERSION 3.20.0)
find_package(Zephyr REQUIRED HINTS $ENV{ZEPHYR_BASE})
project(_zvm)

target_sources(app PRIVATE src/main.c)
```

## prj.conf
```kconfig
# Project configuration
# Copyright (c) 2021 Huang Jiajia 
# Email: Huangjj2020@hnu.edu.cn

# Shell 
CONFIG_SHELL=y
CONFIG_GETOPT=y

# ZVM
CONFIG_ZVM=y
CONFIG_MAX_VM_NUM=64
CONFIG_MAX_VCPU_PER_VM=1

# SMP
CONFIG_SMP=y

# C minimal lib
CONFIG_MINIMAL_LIBC_RAND=y
CONFIG_MINIMAL_LIBC_MALLOC_ARENA_SIZE=2048

# MEM_POOL
CONFIG_HEAP_MEM_POOL_SIZE=8192
```

## src/main.c
```c
/*
 * THIS FILE IS PART OF ZVM PROJECT - main.c
 *
 * Copyright (c) 2021 Huang Jiajia 
 * Email: Huangjj2020@hnu.edu.cn
 * Date: 2021-12-07
 * SPDX-License-Identifier: Apache-2.0
 */

#include <zephyr.h>
#include <sys/printk.h>
#include <shell/shell.h>
#include <zvm.h>
#include <_zvm/vm/vm.h>
#include <_zvm/vm/vm_mm.h>
#include <_zvm/asm/mm.h>


void vm_mm_test()
{
   struct vm *vm;
   struct zvm_mm_struct *z_mm;
   uint64_t base_addr = 0x0;
   uint64_t size = 4096;
   int ret = 0;

   vm = k_malloc(sizeof(struct vm));
   z_mm = k_malloc(sizeof(struct zvm_mm_struct));
   printk("prepare alloc memory!");
   vm->z_mm = z_mm;

   zvm_mm_struct_init(vm);
   printk("mm_struct init successful!");

   ret = vm_mm_init(vm, base_addr, size, NORMAL_MEM);
   if(ret)
      printk("mm test error!");
   else
      printk("mm init successful!");

}

int main(int argc, char **argv){
   //int ret = zvm_init();
   //printk("ZVM test. ret = %d.\n", ret);
   //zvm_info_print(zvm_overall_info->hw_info);
   vm_mm_test();

   return 0;
}
```
