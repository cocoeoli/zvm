## CMakeLists.txt
```
# SPDX-License-Identifier: Apache-2.0

cmake_minimum_required(VERSION 3.20.0)

find_package(Zephyr REQUIRED HINTS $ENV{ZEPHYR_BASE})
project(hypervisor)

target_sources(app PRIVATE src/main.c)
```

## prj.conf
```kconfig
# Project configuration
# Copyright (c) 2021 Huang Jiajia 
# Email: Huangjj2020@hnu.edu.cn

# Shell 
CONFIG_SHELL=y
CONFIG_SHELL_GETOPT=y

# Hypervisor
CONFIG_HYPERVISOR=y
```

## src/main.c
```c
/*
 * THIS FILE IS PART OF ZephyrVisor PROJECT
 * main.c - 
 *
 * Copyright (c) 2012-2014 Wind River Systems, Inc. 
 * Copyright (c) 2021 Huang Jiajia 
 * Email: Huangjj2020@hnu.edu.cn
 * Date: 2021-12-07
 * SPDX-License-Identifier: Apache-2.0
 */

#include <zephyr.h>
#include <sys/printk.h>
#include <shell/shell.h>
#include <hypervisor/hypervisor.h>

int main(int argc, char **argv)
{
   printk("Hypervisor test.../n");
   return 0;
}
```
