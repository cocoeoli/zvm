## zephyr/build/Kconfig/Kconfig.modules
```kconfig
menu "CANopenNode (/home/ubuntu/github/ZephyrVisor/modules/lib/canopennode)"
osource "$(ZEPHYR_CANOPENNODE_KCONFIG)"
config ZEPHYR_CANOPENNODE_MODULE
	bool
	default y
endmenu
menu "hal_gigadevice (/home/ubuntu/github/ZephyrVisor/modules/hal/gigadevice)"
osource "$(ZEPHYR_HAL_GIGADEVICE_KCONFIG)"
config ZEPHYR_HAL_GIGADEVICE_MODULE
	bool
	default y
endmenu
menu "hal_nordic (/home/ubuntu/github/ZephyrVisor/modules/hal/nordic)"
osource "$(ZEPHYR_HAL_NORDIC_KCONFIG)"
config ZEPHYR_HAL_NORDIC_MODULE
	bool
	default y
endmenu
menu "hal_nxp (/home/ubuntu/github/ZephyrVisor/modules/hal/nxp)"
osource "$(ZEPHYR_HAL_NXP_KCONFIG)"
config ZEPHYR_HAL_NXP_MODULE
	bool
	default y
endmenu
menu "loramac-node (/home/ubuntu/github/ZephyrVisor/modules/lib/loramac-node)"
osource "$(ZEPHYR_LORAMAC_NODE_KCONFIG)"
config ZEPHYR_LORAMAC_NODE_MODULE
	bool
	default y
endmenu
menu "lz4 (/home/ubuntu/github/ZephyrVisor/modules/lib/lz4)"
osource "$(ZEPHYR_LZ4_KCONFIG)"
config ZEPHYR_LZ4_MODULE
	bool
	default y
endmenu
menu "mbedtls (/home/ubuntu/github/ZephyrVisor/modules/crypto/mbedtls)"
osource "$(ZEPHYR_MBEDTLS_KCONFIG)"
config ZEPHYR_MBEDTLS_MODULE
	bool
	default y
endmenu
menu "nanopb (/home/ubuntu/github/ZephyrVisor/modules/lib/nanopb)"
osource "$(ZEPHYR_NANOPB_KCONFIG)"
config ZEPHYR_NANOPB_MODULE
	bool
	default y
endmenu
menu "sof (/home/ubuntu/github/ZephyrVisor/modules/audio/sof)"
osource "/home/ubuntu/github/ZephyrVisor/modules/audio/sof/zephyr/Kconfig"
config ZEPHYR_SOF_MODULE
	bool
	default y
endmenu
menu "tflite-micro (/home/ubuntu/github/ZephyrVisor/modules/lib/tflite-micro)"
osource "$(ZEPHYR_TFLITE_MICRO_KCONFIG)"
config ZEPHYR_TFLITE_MICRO_MODULE
	bool
	default y
endmenu
menu "TraceRecorder (/home/ubuntu/github/ZephyrVisor/modules/debug/TraceRecorder)"
osource "/home/ubuntu/github/ZephyrVisor/modules/debug/TraceRecorder/kernelports/Zephyr/Kconfig"
config ZEPHYR_TRACERECORDER_MODULE
	bool
	default y
endmenu
menu "trusted-firmware-m (/home/ubuntu/github/ZephyrVisor/modules/tee/tf-m/trusted-firmware-m)"
osource "$(ZEPHYR_TRUSTED_FIRMWARE_M_KCONFIG)"
config ZEPHYR_TRUSTED_FIRMWARE_M_MODULE
	bool
	default y
endmenu
menu "zscilib (/home/ubuntu/github/ZephyrVisor/modules/lib/zscilib)"
osource "/home/ubuntu/github/ZephyrVisor/modules/lib/zscilib/Kconfig.zscilib"
config ZEPHYR_ZSCILIB_MODULE
	bool
	default y
endmenu
```

## zephyr/subsys/_zvm/Kconfig
```kconfig
# ZVM configuration options

# Copyright (c) 2021 Huang Jiajia
# Email: Huanhjj2020@hnu.edu.cn
# Date: 2021-12-07
# SPDX-License-Identifier: Apache-2.0

menuconfig ZVM
	bool "ZVM"
	help
	  Zephyr virtualization support.

if ZVM

config CONFIG_ZVM
	bool "Set shell for zvm"
	default y    
	help
	  The zvm app have a top shell to receive command, such as zvm.

config MAX_VM_NUM
	int "Maximum number of simultaneous VMs"
	depends on CONFIG_ZVM
	range 0 64
	default 64
	help
	  Maximum number of simultaneous VMs

config MAX_VCPU_PER_VM
	int "Maximum number of vcpu a vm possese"
	depends on CONFIG_ZVM
	range 1 4
	default 1
	help
	  Maximum number of vcpu a vm possese

endif   # ZVM
```

## zephyr/subsys/hypervisor/Kconfig
```kconfig
# Hypervisor configuration options

# Copyright (c) 2021 Huang Jiajia
# Email: Huanhjj2020@hnu.edu.cn
# Date: 2021-12-07
# SPDX-License-Identifier: Apache-2.0

menuconfig HYPERVISOR
	bool "Hypervisor"

if HYPERVISOR

config CONFIG_HYPERVISOR
	bool "Set shell for hypervisor"
	default y    
	help
	  The hypervisor app have a top shell to receive command, such as zvisor.

endif   # HYPERVISOR
```
